## boards/shields/HawkV01/Kconfig.defconfig
```kconfig
if SHIELD_HAWKV0_LEFT

config ZMK_KEYBOARD_NAME
    default "HawkV01"

config ZMK_SPLIT_ROLE_CENTRAL
    default y

endif

if SHIELD_HAWKV01_LEFT || SHIELD_HAWKV01_RIGHT

config ZMK_SPLIT
    default y

endif
```

## boards/shields/HawkV01/Kconfig.shield
```kconfig
# Copyright (c) 2020 Pete Johanson
# SPDX-License-Identifier: MIT

config SHIELD_HAWKV01_LEFT
    def_bool $(shields_list_contains,HawkV01_left)

config SHIELD_HAWKV01_RIGHT
    def_bool $(shields_list_contains,HawkV01_right)
```
