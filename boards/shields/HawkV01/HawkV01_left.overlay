/*
 * Copyright (c) 2020 Pete Johanson
 *
 * SPDX-License-Identifier: MIT
 */

#include "HawkV01.dtsi"
#include <physical_layouts.dtsi>

&kscan0 {
    col-gpios
        = <&pro_micro 1 GPIO_ACTIVE_HIGH>
        , <&pro_micro 0 GPIO_ACTIVE_HIGH>
        , <&pro_micro 2 GPIO_ACTIVE_HIGH>
        , <&pro_micro 3 GPIO_ACTIVE_HIGH>
        , <&pro_micro 4 GPIO_ACTIVE_HIGH>
        , <&pro_micro 5 GPIO_ACTIVE_HIGH>
        ;
};

/*
&left_encoder {
    status = "okay";
};
*/
